## firmware/lab/power-test/main/Kconfig.projbuild
```kconfig
menu "MCL02M power-stage bring-up firmware"

config MCL02M_STA_SSID
    string "Optional home Wi-Fi SSID"
    default ""

config MCL02M_STA_PASSWORD
    string "Optional home Wi-Fi password"
    default ""

config MCL02M_TEST_AP_PASSWORD
    string "Fallback test AP password"
    default "mcl02m-test"

config MCL02M_OLED_CS_GPIO
    int "OLED CS GPIO"
    range -1 39
    default 0

endmenu
```

## firmware/lab/ui-test/main/Kconfig.projbuild
```kconfig
menu "MCL02M UI test firmware"

config MCL02M_STA_SSID
    string "Optional home Wi-Fi SSID"
    default ""
    help
        Optional build-time STA SSID. Leave empty to configure Wi-Fi in RAM
        from the local test page. It is never stored in NVS.

config MCL02M_STA_PASSWORD
    string "Optional home Wi-Fi password"
    default ""

config MCL02M_TEST_AP_PASSWORD
    string "Fallback test AP password"
    default "mcl02m-test"

config MCL02M_OLED_CS_GPIO
    int "Candidate OLED CS GPIO"
    range -1 39
    default 0
    help
        Static analysis indicates GPIO0. Set -1 only for the deliberate
        no-CS retry build if the first OLED test produces no image.

endmenu
```

## firmware/production/main/Kconfig.projbuild
```kconfig
menu "MCL02M custom firmware"

config MCL02M_OLED_CS_GPIO
    int "OLED CS GPIO"
    range -1 39
    default 0

config MCL02M_SETUP_AP_PASSWORD
    string "Initial setup AP password"
    default "12345678"

config MCL02M_HOSTNAME
    string "LAN hostname"
    default "mcl02m-cooker"

endmenu
```

## firmware/production/sdkconfig.defaults
```kconfig
CONFIG_IDF_TARGET="esp32"
CONFIG_PARTITION_TABLE_CUSTOM=y
CONFIG_PARTITION_TABLE_CUSTOM_FILENAME="partitions.csv"
CONFIG_PARTITION_TABLE_OFFSET=0x8000
CONFIG_ESPTOOLPY_FLASHSIZE_16MB=y
CONFIG_ESPTOOLPY_FLASHSIZE="16MB"
CONFIG_FREERTOS_UNICORE=y
CONFIG_FREERTOS_HZ=1000
CONFIG_ESP_TASK_WDT_EN=y
CONFIG_ESP_TASK_WDT_INIT=y
CONFIG_ESP_TASK_WDT_PANIC=y
CONFIG_ESP_TASK_WDT_TIMEOUT_S=5
CONFIG_ESP_TASK_WDT_CHECK_IDLE_TASK_CPU0=y
CONFIG_COMPILER_OPTIMIZATION_SIZE=y
CONFIG_LOG_DEFAULT_LEVEL_INFO=y
CONFIG_ESP_MAIN_TASK_STACK_SIZE=8192
CONFIG_ESP_WIFI_NVS_ENABLED=n
CONFIG_ESP_PHY_CALIBRATION_AND_DATA_STORAGE=n
CONFIG_HTTPD_WS_SUPPORT=y
CONFIG_MCL02M_OLED_CS_GPIO=0
CONFIG_MCL02M_SETUP_AP_PASSWORD="12345678"
CONFIG_MCL02M_HOSTNAME="mcl02m-cooker"
```
